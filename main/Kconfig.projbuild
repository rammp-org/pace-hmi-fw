## main/Kconfig.projbuild
```kconfig
menu "RAMMP HMI"

    config HMI_REMOTE_UI
        bool "Remote UI debug channel (screenshots + input injection)"
        default n
        help
            Opens a TCP server on port 3333 that hands out the current frame as
            raw RGB565 and injects touch, joystick and button input, so the whole
            UI can be walked and captured from scripts/hmi_ui.py instead of by
            someone looking at the panel.

            On its own it cannot drive the chair: injected joystick directions
            only move the UI's focus and never reach the stick values sent to
            the MCB (HMI_BENCH_STICK_INJECT below changes that). It CAN press
            anything on screen -- ACTIVATE DRIVE, the seat and actuator jog
            buttons -- and it has no authentication, so anything on the same
            network can.

            Off by default for that reason. Turn it on in your local sdkconfig
            (which is not in git) while working on the UI, not in
            sdkconfig.defaults -- that one ships.

    config HMI_BENCH_STICK_INJECT
        bool "Bench: stick injection over the remote UI (STICK verb)"
        depends on HMI_REMOTE_UI
        default n
        help
            Adds the remote UI verb
                STICK <h_mv> <v_mv> <twist_mv> <fail_mask> <seq>
            which replaces the ADC task's three raw stick reads (millivolts,
            before calibration) for 300 ms; a script refreshes it to hold a
            value (scripts/hmi_ui.py stick). fail_mask makes reads fail (bit
            0 horizontal, 1 vertical, 2 twist). Everything after the reads is
            the real code: calibration, mapping, keys, the gate, XYTwist. A
            red "STICK INJECTED" label shows on top of every screen while it
            holds. A calibration run during an injection calibrates on the
            injected values.

            THIS COMMANDS MOTION: an injected deflection reaches the MCB
            whenever the gate is open, from anything on the network (the
            remote UI has no authentication). Bench only, with a simulated MCB
            (hazard-fixes.md B1); never in sdkconfig.defaults, which ships (L0
            checks it, and the Build workflow checks that the release ELF has
            no injection symbol). ci/sdkconfig.stick_inject turns it on for
            the bench_inject variant.

    # Hidden: CONFIG_HMI_BENCH_STICK_INJECT as 0/1, always defined, so the C++
    # reads it as a constexpr with no preprocessor conditional (CS-TYP-05; the
    # L0 ratchet's if_config count). See HMI_BENCH_DA7280_TEST_AS_INT.
    config HMI_BENCH_STICK_INJECT_AS_INT
        int
        default 1 if HMI_BENCH_STICK_INJECT
        default 0

    # Hidden: 1 when the bootloader may skip validating the app image (any
    # BOOTLOADER_SKIP_VALIDATE_* option). The quick POST's img.ok takes "verified" from
    # the bootloader's own validation and static_asserts this is 0 (hazard-c3-spec.md
    # Q10, decision C7 a), so a build that skips it does not compile.
    config HMI_BOOTLOADER_SKIPS_VALIDATE_AS_INT
        int
        default 1 if BOOTLOADER_SKIP_VALIDATE_ALWAYS || BOOTLOADER_SKIP_VALIDATE_ON_POWER_ON || BOOTLOADER_SKIP_VALIDATE_IN_DEEP_SLEEP
        default 0

    config HMI_WIFI_SSID
        string "WiFi network name (SSID)"
        default ""
        help
            The network the HMI joins when Internet Settings is on WiFi (the
            Tab5's ESP32-C6, 2.4 GHz only), until one is joined from that
            screen. Empty, with none joined = no WiFi: the HMI uses Ethernet
            (the W5500) whatever that setting says.

            Set it, and HMI_WIFI_PASSWORD, in your local sdkconfig (not in git),
            never in sdkconfig.defaults. A network behind a login page (a
            captive portal) will not work: nothing on the HMI can log in.

    config HMI_WIFI_PASSWORD
        string "WiFi password"
        default ""
        help
            WPA2/WPA3 passphrase for HMI_WIFI_SSID. Empty = an open network.

    config HMI_OTA_TEST_URL
        string "Firmware update: one more image to offer, from this URL"
        default ""
        help
            Settings > Firmware update lists the GitHub releases. Set this and
            the list starts with one more entry, "Test image", that installs
            whatever this URL serves -- an http:// one is fine -- so an update
            can be tried before it is published, e.g.

                python -m http.server 8070 --directory build
                http://<this PC>:8070/rammp-hmi-p4.bin

            The same checks apply as to a release, except that there is no
            digest to compare it with. For your local sdkconfig only; empty in
            sdkconfig.defaults, which ships.

    config HMI_BENCH_DA7280_TEST
        bool "Bench: DA7280 haptic driver tests at boot"
        default n
        help
            Runs the DA7280 bring-up probe (CHIP_REV read) and the driver's
            functional test from app_main, before the IO expanders come up:
            15 numbered vibrations ([DA7280 TEST NN/15]) on the LRA, with
            pauses, so boot takes that much longer and the motor buzzes.

            A bench feature (CS-LAY-09): off by default and in
            sdkconfig.defaults, which ships; ci/sdkconfig.bench turns it on for
            the bench variant L0 builds. The self test's DA7280 row does not
            depend on it: that one reads the boot I2C probe.

    # Hidden: CONFIG_HMI_BENCH_DA7280_TEST as 0/1. sdkconfig.h leaves an unset
    # bool undefined, so without this the C++ would need #ifdef to read it; an
    # int is always defined and becomes a constexpr with no preprocessor
    # conditional (CS-TYP-05; the L0 ratchet's if_config count).
    config HMI_BENCH_DA7280_TEST_AS_INT
        int
        default 1 if HMI_BENCH_DA7280_TEST
        default 0

    config HMI_DEBUG_FPS
        bool "Debug: per-second frame-rate report ([FPS])"
        default n
        help
            Measures what LVGL actually renders (RENDER_START to RENDER_READY)
            and logs once a second, at debug level under the "fps" tag:
                [FPS] 59.8 fps | render avg 4.12 ms | max 6.03 ms
            It also loads the Drive screen at boot instead of the boot screen,
            whose logo would otherwise dominate the numbers.

            A debug feature (CS-LAY-09): off by default and never in
            sdkconfig.defaults, which ships. Turn it on in your local sdkconfig.

    config HMI_DEBUG_FPS_STRESS
        bool "Debug: invalidate the whole screen every LVGL cycle"
        depends on HMI_DEBUG_FPS
        default n
        help
            A static SquareLine screen invalidates nothing and renders nothing,
            so HMI_DEBUG_FPS alone measures an idle screen. This forces a full
            redraw every cycle: the sustained worst case.

    # Hidden: the two FPS options as 0/1. sdkconfig.h leaves an unset bool
    # undefined, so without these the C++ would need #ifdef to read them; an
    # int is always defined and becomes a constexpr with no preprocessor
    # conditional (CS-TYP-05; the L0 ratchet's if_config count).
    config HMI_DEBUG_FPS_AS_INT
        int
        default 1 if HMI_DEBUG_FPS
        default 0

    config HMI_DEBUG_FPS_STRESS_AS_INT
        int
        default 1 if HMI_DEBUG_FPS_STRESS
        default 0

endmenu
```
